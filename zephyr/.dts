&spi1 {
    compatible = "nordic,nrf-spim";
    ls7366r: ls7366r@0 {
        compatible = "ls7366r";
        reg = <0>;
        spi-max-frequency = <1000000>;
        cs-gpios = <&gpio0 4 GPIO_ACTIVE_LOW>;
    };
};
