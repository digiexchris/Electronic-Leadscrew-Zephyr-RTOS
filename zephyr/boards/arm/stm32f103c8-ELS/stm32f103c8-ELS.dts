/*
 * Copyright (c) 2017, embedjournal.com
 *
 * SPDX-License-Identifier: Apache-2.0
 */

/dts-v1/;
#include "stm32_min_dev.dtsi"

/ {
	model = "STM32 Minimum Development Board (Blue)";
	compatible = "stm32_min_dev_blue", "st,stm32f103c8";

	leds {
		led: led {
			gpios = <&gpioc 13 GPIO_ACTIVE_LOW>;
		};
	};

	ls7366r: ls7366r {
        compatible = "ls7366r";
        spi-max-frequency = <1000000>;
        cs-gpios = <&gpioa 4 GPIO_ACTIVE_LOW>;
    };
};
